// SPDX-License-Identifier: GPL-2.0-only
/*
 * Copyright (C) 2022 Robert Nelson <robertcnelson@gmail.com>
 */

/dts-v1/;
/plugin/;

/*
 * Helper to show loaded overlays under: /proc/device-tree/chosen/overlays/
 */
&{/chosen} {
	overlays {
		BB-I2C2-HSC.kernel = __TIMESTAMP__;
	};
};

&i2c2 {
	status = "okay";

	clock-frequency = <400000>;

	#address-cells = <1>;
	#size-cells = <0>;

	hsc@28 {
		status = "okay";
		compatible = "honeywell,hsc";
		reg = <0x28>;
	};
};
